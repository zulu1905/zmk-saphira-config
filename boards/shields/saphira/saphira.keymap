#include <behaviors.dtsi>
#include <dt-bindings/zmk/keys.h>
#include <dt-bindings/zmk/bt.h>
#include <dt-bindings/zmk/mouse.h>

/ {
    keymap {
        compatible = "zmk,keymap";

        default_layer {
            bindings = <
                &mkp LCLK    /* Sol Tık */
                &mkp RCLK    /* Sağ Tık */
                &mkp MCLK    /* Orta Tık */
            >;
        };
    };
};
